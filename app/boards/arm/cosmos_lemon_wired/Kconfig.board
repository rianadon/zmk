## app/boards/arm/cosmos_lemon_wired/Kconfig.board
```kconfig
# SPDX-License-Identifier: MIT

config BOARD_COSMOS_LEMON_WIRED
	bool "cosmos_lemon_wired"
	depends on SOC_RP2040
```

## app/boards/arm/cosmos_lemon_wired/Kconfig.defconfig
```kconfig
# SPDX-License-Identifier: MIT

if BOARD_COSMOS_LEMON_WIRED

config BOARD
	default "cosmos_lemon_wired"

# Lemon Wired ships a W25Q-series 8MB flash. The `_W25Q080` selector here
# is named after the smaller 1MB W25Q080 but picks the same second-stage
# bootloader binary (W25Q-family); flash size is set independently in the
# DTS partition layout (DT_SIZE_M(8)).
config RP2_FLASH_W25Q080
	default y

config USB_SELF_POWERED
	default n

endif # BOARD_COSMOS_LEMON_WIRED
```

## app/boards/arm/cosmos_lemon_wired/cosmos_lemon_wired_defconfig
```kconfig
# SPDX-License-Identifier: MIT

CONFIG_SOC_SERIES_RP2XXX=y
CONFIG_SOC_RP2040=y
CONFIG_BOARD_COSMOS_LEMON_WIRED=y

CONFIG_SYS_CLOCK_HW_CYCLES_PER_SEC=125000000

# Pinctrl + GPIO
CONFIG_PINCTRL=y
CONFIG_GPIO=y

# UART for the wired-split link
CONFIG_SERIAL=y
CONFIG_UART_INTERRUPT_DRIVEN=y

CONFIG_RESET=y

# Flash + code partition
CONFIG_FLASH=y
CONFIG_FLASH_PAGE_LAYOUT=y
CONFIG_FLASH_MAP=y
CONFIG_USE_DT_CODE_PARTITION=y
CONFIG_NVS=y
CONFIG_SETTINGS_NVS=y
CONFIG_BUILD_OUTPUT_UF2=y

# Native USB device available — but the legacy CONFIG_USB_DEVICE_STACK
# is intentionally NOT enabled here. Apps that need the legacy stack
# select it via ZMK_USB; apps that need USBD-next set
# CONFIG_USB_DEVICE_STACK_NEXT=y. The two can't coexist when both
# instantiate CDC ACM (linker chokes on duplicated DT instance
# ordinals), so leaving the choice to the per-shield .conf avoids
# baking it in here.
```

## app/boards/arm/cosmos_lemon_wireless/Kconfig.board
```kconfig
# SPDX-License-Identifier: MIT

config BOARD_COSMOS_LEMON_WIRELESS
    bool "cosmos_lemon_wireless"
    depends on SOC_NRF52840_QIAA

config BOARD_COSMOS_LEMON_WIRELESS_V4
    bool "cosmos_lemon_wireless v0.4"
    depends on SOC_NRF52840_QIAA
```

## app/boards/arm/cosmos_lemon_wireless/Kconfig.defconfig
```kconfig
# SPDX-License-Identifier: MIT

if BOARD_COSMOS_LEMON_WIRELESS || BOARD_COSMOS_LEMON_WIRELESS_V4

config BOARD
    default "cosmos_lemon_wireless"

if USB_DEVICE_STACK

config USB_NRFX
    default y

endif # USB_DEVICE_STACK

config BT_CTLR
    default BT

endif # BOARD_COSMOS_LEMON_WIRELESS || BOARD_COSMOS_LEMON_WIRELESS_V4
```

## app/boards/shields/cosmos_lemon_wired/Kconfig.defconfig
```kconfig
# Copyright (c) 2026 The ZMK Contributors
# SPDX-License-Identifier: MIT

if SHIELD_COSMOS_LEMON_WIRED_LEFT

config ZMK_KEYBOARD_NAME
    default "Lemon Wired"

config ZMK_SPLIT_ROLE_CENTRAL
    default y

config ZMK_SPLIT_USB
    default y

endif # SHIELD_COSMOS_LEMON_WIRED_LEFT

if SHIELD_COSMOS_LEMON_WIRED_RIGHT

config ZMK_SPLIT_USB
    default y

endif # SHIELD_COSMOS_LEMON_WIRED_RIGHT

if SHIELD_COSMOS_LEMON_WIRED_LEFT || SHIELD_COSMOS_LEMON_WIRED_RIGHT

config ZMK_SPLIT
    default y

endif # SHIELD_COSMOS_LEMON_WIRED_LEFT || SHIELD_COSMOS_LEMON_WIRED_RIGHT
```

## app/boards/shields/cosmos_lemon_wired/Kconfig.shield
```kconfig
# Copyright (c) 2026 The ZMK Contributors
# SPDX-License-Identifier: MIT

config SHIELD_COSMOS_LEMON_WIRED_LEFT
    def_bool $(shields_list_contains,cosmos_lemon_wired_left)

config SHIELD_COSMOS_LEMON_WIRED_RIGHT
    def_bool $(shields_list_contains,cosmos_lemon_wired_right)
```

## app/boards/shields/lemon_usb_split_test/Kconfig.defconfig
```kconfig
# Copyright (c) 2026 The ZMK Contributors
# SPDX-License-Identifier: MIT

if SHIELD_LEMON_USB_SPLIT_TEST_LEFT

config ZMK_KEYBOARD_NAME
    default "Lemon USB Split"

config ZMK_SPLIT_ROLE_CENTRAL
    default y

config ZMK_SPLIT_USB
    default y

endif

if SHIELD_LEMON_USB_SPLIT_TEST_RIGHT

config ZMK_SPLIT_USB
    default y

endif

if SHIELD_LEMON_USB_SPLIT_TEST_LEFT || SHIELD_LEMON_USB_SPLIT_TEST_RIGHT

config ZMK_SPLIT
    default y

endif
```

## app/boards/shields/lemon_usb_split_test/Kconfig.shield
```kconfig
# Copyright (c) 2026 The ZMK Contributors
# SPDX-License-Identifier: MIT

config SHIELD_LEMON_USB_SPLIT_TEST_LEFT
    def_bool $(shields_list_contains,lemon_usb_split_test_left)

config SHIELD_LEMON_USB_SPLIT_TEST_RIGHT
    def_bool $(shields_list_contains,lemon_usb_split_test_right)
```

## app/dts/bindings/zmk,usb-split.yaml
```yaml
# Copyright (c) 2026 The ZMK Contributors
# SPDX-License-Identifier: MIT

description: |
  Top-level node for the USB-based ZMK split transport
  (CONFIG_ZMK_SPLIT_USB). Identifies the host-side UHC controller the
  central drives. The peripheral half doesn't reference this binding —
  it gets its UDC via standard USBD-next class registration.

compatible: "zmk,usb-split"

properties:
  uhc:
    type: phandle
    required: true
    description: |
      UHC (USB host controller) phandle on the central side. Typically
      `&pio_usb_host` (raspberrypi,pio-usb-host). Ignored on peripheral
      builds.
```

## app/src/split/Kconfig
```kconfig
# Copyright (c) 2022 The ZMK Contributors
# SPDX-License-Identifier: MIT

menuconfig ZMK_SPLIT
    bool "Split keyboard support"

if ZMK_SPLIT

config ZMK_SPLIT_ROLE_CENTRAL
    bool "Split central device"

config ZMK_SPLIT_BLE
    bool "BLE Split"
    default y
    depends on ZMK_BLE
    select BT_USER_PHY_UPDATE
    select BT_AUTO_PHY_UPDATE

config ZMK_SPLIT_WIRED
    bool "Wired Split"
    default y if !ZMK_SPLIT_BLE
    depends on DT_HAS_ZMK_WIRED_SPLIT_ENABLED
    select SERIAL
    select RING_BUFFER
    select CRC

config ZMK_SPLIT_USB
    bool "USB Split (Pico-PIO-USB on RP2040)"
    depends on SOC_RP2040
    select RING_BUFFER
    select CRC
    help
      Carry split keymap commands + events over a USB bulk pair on a
      Pico-PIO-USB interface. Central side selects UHC_PIO_USB; the
      peripheral half selects UDC_PIO_USB. The two halves communicate
      over a USB-C cable between their PIO-USB ports (e.g. the Lemon
      Wired's "Link" USB-C port pair). Phase 2 of the Lemon Wired ZMK
      roadmap.

config ZMK_SPLIT_PERIPHERAL_HID_INDICATORS
    bool "Peripheral HID Indicators"
    depends on ZMK_HID_INDICATORS
    help
      Enable propagating the HID (LED) Indicator state to the split peripheral(s).

endif # ZMK_SPLIT

rsource "bluetooth/Kconfig"
rsource "wired/Kconfig"
rsource "usb/Kconfig"
```

## app/src/split/usb/Kconfig
```kconfig
# Copyright (c) 2026 The ZMK Contributors
# SPDX-License-Identifier: MIT

if ZMK_SPLIT_USB

config ZMK_SPLIT_USB_CMD_BUFFER_ITEMS
	int "Number of central commands to queue toward the peripheral"
	default 4
	help
	  Each in-flight command consumes ZMK_SPLIT_USB_CMD_PACKET_SIZE bytes
	  of static buffer plus a UHC transfer slot. The peripheral processes
	  them in order; this knob bounds the burst tolerance for the
	  send_command path.

config ZMK_SPLIT_USB_EVENT_BUFFER_ITEMS
	int "Number of peripheral events to queue toward the central"
	default 8
	help
	  The peripheral may report several events (key press + sensor +
	  HID indicator) within a single bulk-IN window — this bounds how
	  many can be batched before the central reads them out.

config ZMK_SPLIT_USB_TRANSFER_TIMEOUT_MS
	int "Bulk transfer timeout in milliseconds"
	default 1000
	help
	  Maximum time the central waits for a bulk IN/OUT transfer to
	  complete before giving up and rescheduling. Should be longer than
	  the worst-case bus reset + re-enumeration on the wire (50 ms +
	  enumeration round-trips), shorter than user-perceptible split
	  latency.

config ZMK_SPLIT_USB_LOG_LEVEL
	int "USB split transport log level"
	default 2
	range 0 4

endif # ZMK_SPLIT_USB
```

## app/src/split/usb/Kconfig.defaults
```kconfig
# Copyright (c) 2026 The ZMK Contributors
# SPDX-License-Identifier: MIT

if ZMK_SPLIT_USB

# Central side: drives a UHC controller (Pico-PIO-USB on Link).
config UHC_PIO_USB
    default y if ZMK_SPLIT_ROLE_CENTRAL

config UHC_DRIVER
    default y if ZMK_SPLIT_ROLE_CENTRAL

# Central uses k_calloc to allocate uhc_transfer descriptors per
# in-flight transfer + net_bufs for transfer payloads.
config NET_BUF
    default y if ZMK_SPLIT_ROLE_CENTRAL

config HEAP_MEM_POOL_SIZE
    default 4096 if ZMK_SPLIT_ROLE_CENTRAL

# Peripheral side: legacy USB device stack on the native USB-C,
# exposing a CDC ACM serial port that the central enumerates and uses
# as the bulk transport. Mature, in-tree CDC ACM avoids the
# udc_pio_usb path entirely on the peripheral. Requires
# CONFIG_USB_DEVICE_STACK + CONFIG_USB_CDC_ACM and a zephyr,cdc-acm-uart
# DT node under zephyr_udc0 in the per-shield overlay.

endif # ZMK_SPLIT_USB
```

## app/west.yml
```yaml
manifest:
  remotes:
    - name: zephyrproject-rtos
      url-base: https://github.com/zephyrproject-rtos
    - name: zmkfirmware
      url-base: https://github.com/zmkfirmware
    - name: sekigon-gonnoc
      url-base: https://github.com/sekigon-gonnoc
    - name: Olson3R
      url-base: https://github.com/Olson3R
  projects:
    - name: zephyr
      remote: zmkfirmware
      revision: v3.5.0+zmk-fixes
      clone-depth: 1
      import:
        name-blocklist:
          - ci-tools
          - hal_altera
          - hal_cypress
          - hal_infineon
          - hal_microchip
          - hal_nxp
          - hal_openisa
          - hal_silabs
          - hal_xtensa
          - hal_st
          - hal_ti
          - loramac-node
          - mcuboot
          - mcumgr
          - net-tools
          - openthread
          - edtt
          - trusted-firmware-m
    - name: nanopb
      revision: 8c60555d6277a0360c876bd85d491fc4fb0cd74a
      path: modules/lib/nanopb
      remote: zmkfirmware
    - name: zmk-studio-messages
      revision: 6cb4c283e76209d59c45fbcb218800cd19e9339d
      path: modules/msgs/zmk-studio-messages
      remote: zmkfirmware
    # Pico-PIO-USB upstream (sekigon-gonnoc/Pico-PIO-USB) — bit-banged USB
    # PHY+controller for RP2040. Phase 2 of the Lemon Wired ZMK roadmap
    # uses it as the inter-half link on the second USB-C port.
    - name: Pico-PIO-USB
      remote: sekigon-gonnoc
      # Post-0.7.2 main: includes 38ed543 "optimize to reduce delay
      # between received DATA and sending handshake" — inlines
      # pio_usb_bus_send_handshake and caches PIO/SM/rx_buffer in
      # locals to tighten the DATA→ACK turnaround. Without this, our
      # IN STATUS for SET_ADDRESS appears to ACK on the host side but
      # the device misses our ACK (timing-critical, must arrive within
      # 6.5–7.5 bit-times of EOP) and never commits the new address.
      revision: 675543bcc9baa8170f868ab7ba316d418dbcf41f # main @ post-0.7.2
      path: modules/lib/pico-pio-usb
    # Zephyr glue exposing Pico-PIO-USB as UHC + UDC drivers.
    # Pinned at the cleanup of the B4 working state (single-xfer
    # control transfers + per-tick xfer pumping + STATUS direction
    # fix); see the phase-2-samples branch for context.
    - name: zephyr-module-pio-usb
      remote: Olson3R
      revision: v0.1.0
      path: modules/lib/zephyr-pio-usb
  self:
    west-commands: scripts/west-commands.yml
```
