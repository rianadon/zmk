/*
 * Copyright (c) 2021 The ZMK Contributors
 *
 * SPDX-License-Identifier: MIT
 */

/dts-v1/;
#include "cosmos_lemon_wireless.dtsi"

/ {
    chosen {
        zmk,battery = &vbatt;
    };

    // Node name must match original "EXT_POWER" label to preserve user settings.
    EXT_POWER {
        compatible = "zmk,ext-power-generic";
        control-gpios = <&gpio0 2 GPIO_ACTIVE_LOW>;
    };

    vbatt: vbatt {
        compatible = "zmk,battery-nrf-vddh";
    };
};
