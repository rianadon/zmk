/*
 * Copyright (c) 2026 The ZMK Contributors
 *
 * SPDX-License-Identifier: MIT
 *
 * Minimal compile-test shield for the Phase-2 USB split transport.
 * No real key matrix; just stands up enough DT to satisfy the build.
 */

/ {
    chosen {
        zmk,kscan = &kscan0;
    };

    kscan0: kscan {
        compatible = "zmk,kscan-mock";
        rows = <1>;
        columns = <1>;
        events = <0>;
    };
};
