/*
 * Copyright (c) 2026 The ZMK Contributors
 * SPDX-License-Identifier: MIT
 *
 * Peripheral side (native UDC variant): expose a CDC ACM serial port
 * on the native USB-C via the legacy USB device stack. Lemon A's UHC
 * (running on its Link USB-C) enumerates this and uses the data-
 * interface bulk endpoints for the split protocol.
 */

#include "lemon_usb_split_test.dtsi"

&zephyr_udc0 {
	zsu_cdc_acm: zsu_cdc_acm {
		compatible = "zephyr,cdc-acm-uart";
	};
};
